
// THIS FILE IS AUTOGENERATED
// DO NOT EDIT, INSTEAD USE:
//  src/make_images.py
//
static_assert(DISP_WIDTH == 16);
static_assert(DISP_HEIGHT == 16);


#define StepSet_COUNT 5
uint16_t StepSet[StepSet_COUNT][16] = {
  // StepSet[0]
  {0x3E00, 0x6100, 0x5100, 0x4918, 0x4918, 0x4900, 0x3E00, 0x0000, 0x0000, 0x2208, 0x5354, 0x5214, 0x5214, 0x5254, 0x2708, 0x0000},
  // +--------------------------------+
  // |                  ()()()()()    |
  // |                ()        ()()  |
  // |                ()      ()  ()  |
  // |      ()()      ()    ()    ()  |
  // |      ()()      ()    ()    ()  |
  // |                ()    ()    ()  |
  // |                  ()()()()()    |
  // |                                |
  // |                                |
  // |      ()          ()      ()    |
  // |    ()  ()  ()  ()()    ()  ()  |
  // |    ()  ()        ()    ()  ()  |
  // |    ()  ()        ()    ()  ()  |
  // |    ()  ()  ()    ()    ()  ()  |
  // |      ()        ()()()    ()    |
  // |                                |
  // +--------------------------------+
  // StepSet[1]
  {0x3E00, 0x6100, 0x5100, 0x4918, 0x4918, 0x4900, 0x3E00, 0x0000, 0x0000, 0x7208, 0x1354, 0x3214, 0x4214, 0x4254, 0x3708, 0x0000},
  // +--------------------------------+
  // |                  ()()()()()    |
  // |                ()        ()()  |
  // |                ()      ()  ()  |
  // |      ()()      ()    ()    ()  |
  // |      ()()      ()    ()    ()  |
  // |                ()    ()    ()  |
  // |                  ()()()()()    |
  // |                                |
  // |                                |
  // |      ()          ()    ()()()  |
  // |    ()  ()  ()  ()()    ()      |
  // |    ()  ()        ()    ()()    |
  // |    ()  ()        ()        ()  |
  // |    ()  ()  ()    ()        ()  |
  // |      ()        ()()()  ()()    |
  // |                                |
  // +--------------------------------+
  // StepSet[2]
  {0x3E00, 0x6100, 0x5100, 0x4918, 0x4918, 0x4900, 0x3E00, 0x0000, 0x0000, 0x2708, 0x5454, 0x5214, 0x5414, 0x5454, 0x2708, 0x0000},
  // +--------------------------------+
  // |                  ()()()()()    |
  // |                ()        ()()  |
  // |                ()      ()  ()  |
  // |      ()()      ()    ()    ()  |
  // |      ()()      ()    ()    ()  |
  // |                ()    ()    ()  |
  // |                  ()()()()()    |
  // |                                |
  // |                                |
  // |      ()        ()()()    ()    |
  // |    ()  ()  ()      ()  ()  ()  |
  // |    ()  ()        ()    ()  ()  |
  // |    ()  ()          ()  ()  ()  |
  // |    ()  ()  ()      ()  ()  ()  |
  // |      ()        ()()()    ()    |
  // |                                |
  // +--------------------------------+
  // StepSet[3]
  {0x3E00, 0x6100, 0x5100, 0x4918, 0x4918, 0x4900, 0x3E00, 0x0000, 0x0000, 0x2208, 0x554C, 0x5508, 0x5508, 0x5548, 0x221C, 0x0000},
  // +--------------------------------+
  // |                  ()()()()()    |
  // |                ()        ()()  |
  // |                ()      ()  ()  |
  // |      ()()      ()    ()    ()  |
  // |      ()()      ()    ()    ()  |
  // |                ()    ()    ()  |
  // |                  ()()()()()    |
  // |                                |
  // |                                |
  // |      ()          ()      ()    |
  // |    ()()    ()  ()  ()  ()  ()  |
  // |      ()        ()  ()  ()  ()  |
  // |      ()        ()  ()  ()  ()  |
  // |      ()    ()  ()  ()  ()  ()  |
  // |    ()()()        ()      ()    |
  // |                                |
  // +--------------------------------+
  // StepSet[4]
  {0x3E00, 0x6100, 0x5100, 0x4918, 0x4918, 0x4900, 0x3E00, 0x0000, 0x0000, 0x2208, 0x5554, 0x5510, 0x5508, 0x5544, 0x221C, 0x0000},
  // +--------------------------------+
  // |                  ()()()()()    |
  // |                ()        ()()  |
  // |                ()      ()  ()  |
  // |      ()()      ()    ()    ()  |
  // |      ()()      ()    ()    ()  |
  // |                ()    ()    ()  |
  // |                  ()()()()()    |
  // |                                |
  // |                                |
  // |      ()          ()      ()    |
  // |    ()  ()  ()  ()  ()  ()  ()  |
  // |        ()      ()  ()  ()  ()  |
  // |      ()        ()  ()  ()  ()  |
  // |    ()      ()  ()  ()  ()  ()  |
  // |    ()()()        ()      ()    |
  // |                                |
  // +--------------------------------+
};



#define MiscIcons_COUNT 1
uint16_t MiscIcons[MiscIcons_COUNT][16] = {
  // MiscIcons[0]
  {0x3AAE, 0x12A2, 0x124E, 0x12A2, 0x12AE, 0x0000, 0x7E14, 0x4214, 0x421C, 0x421C, 0x5208, 0x427F, 0x421C, 0x421C, 0x7E14, 0x0014},
  // +--------------------------------+
  // |  ()()()  ()  ()  ()  ()()()    |
  // |  ()      ()  ()  ()    ()      |
  // |  ()()()    ()    ()    ()      |
  // |  ()      ()  ()  ()    ()      |
  // |  ()()()  ()  ()  ()    ()      |
  // |                                |
  // |    ()  ()        ()()()()()()  |
  // |    ()  ()        ()        ()  |
  // |    ()()()        ()        ()  |
  // |    ()()()        ()        ()  |
  // |      ()          ()    ()  ()  |
  // |()()()()()()()    ()        ()  |
  // |    ()()()        ()        ()  |
  // |    ()()()        ()        ()  |
  // |    ()  ()        ()()()()()()  |
  // |    ()  ()                      |
  // +--------------------------------+
};


// file end
